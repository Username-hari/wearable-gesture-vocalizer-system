## sdkconfig.defaults
```kconfig
# ESP32 SDK defaults for Gesture Vocalizer
CONFIG_IDF_TARGET="esp32"
CONFIG_ESP32_DEFAULT_CPU_FREQ_240=y
CONFIG_ADC_DISABLE_DAC=y
CONFIG_UART_ISR_IN_IRAM=y
CONFIG_LOG_DEFAULT_LEVEL_INFO=y
```
